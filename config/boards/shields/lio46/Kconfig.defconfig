## config/boards/shields/lio46/Kconfig.defconfig
```kconfig
if SHIELD_LIO46_LEFT

# Name must be less than 16 characters long!
config ZMK_KEYBOARD_NAME
    default "Lio 46"

config ZMK_SPLIT_ROLE_CENTRAL
    default y

endif

if SHIELD_LIO46_LEFT || SHIELD_LIO46_RIGHT

config ZMK_SPLIT
    default y

config ZMK_POINTING
    default y

config ZMK_POINTING_SMOOTH_SCROLLING
    default n

config SPI
    default y

config PMW3610
    default y

config PMW3610_SWAP_XY
    default y

config PMW3610_REPORT_INTERVAL_MIN
    default 8

endif
```
